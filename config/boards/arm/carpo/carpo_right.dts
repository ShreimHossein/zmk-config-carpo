/*
*
* Copyright (c) 2024 The ZMK Contributors
* SPDX-License-Identifier: MIT
*
*/

#include "carpo.dtsi"

&kscan0 {
    row-gpios
        = <&gpio1  0 (GPIO_ACTIVE_HIGH | GPIO_PULL_DOWN)>
        , <&gpio1  3 (GPIO_ACTIVE_HIGH | GPIO_PULL_DOWN)>
        , <&gpio0  9 (GPIO_ACTIVE_HIGH | GPIO_PULL_DOWN)>
        , <&gpio0 10 (GPIO_ACTIVE_HIGH | GPIO_PULL_DOWN)>
        ;

    col-gpios
        = <&gpio0 22 GPIO_ACTIVE_HIGH>
        , <&gpio1  6 GPIO_ACTIVE_HIGH>
        , <&gpio1  4 GPIO_ACTIVE_HIGH>
        , <&gpio1  2 GPIO_ACTIVE_HIGH>
        , <&gpio1  1 GPIO_ACTIVE_HIGH>
        ;
};

&matrix_transform0 {
    col-offset = <5>;
};
